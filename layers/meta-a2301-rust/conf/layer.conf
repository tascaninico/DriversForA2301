## layers/meta-a2301-rust/conf/layer.conf
```bitbake
# We have a conf and classes directory, add to BBPATH
BBPATH .= ":${LAYERDIR}"

# We have recipes-* directories, add to BBFILES
BBFILES += "${LAYERDIR}/recipes-*/*/*.bb \
            ${LAYERDIR}/recipes-*/*/*.bbappend"

BBFILE_COLLECTIONS += "meta-a2301-rust"
BBFILE_PATTERN_meta-a2301-rust = "^${LAYERDIR}/"
BBFILE_PRIORITY_meta-a2301-rust = "6"

LAYERDEPENDS_meta-a2301-rust = "core"
LAYERSERIES_COMPAT_meta-a2301-rust = "kirkstone"
```
